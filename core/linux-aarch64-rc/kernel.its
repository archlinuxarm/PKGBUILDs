## core/linux-veyron/kernel.its
```
/dts-v1/;
 
/ {
    description = "Chrome OS kernel image with one or more FDT blobs";
    images {
        kernel@1{
            description = "kernel";
            data = /incbin/("arch/arm/boot/zImage");
            type = "kernel_noload";
            arch = "arm";
            os = "linux";
            compression = "none";
            load = <0>;
            entry = <0>;
        };
        fdt@1{
            description = "rk3288-brain-rev0.dtb";
            data = /incbin/("arch/arm/boot/dts/rk3288-brain-rev0.dtb");
            type = "flat_dt";
            arch = "arm";
            compression = "none";
            hash@1{
                algo = "sha1";
            };
        };
        fdt@2{
            description = "rk3288-jaq-rev1.dtb";
            data = /incbin/("arch/arm/boot/dts/rk3288-jaq-rev1.dtb");
            type = "flat_dt";
            arch = "arm";
            compression = "none";
            hash@1{
                algo = "sha1";
            };
        };
        fdt@3{
            description = "rk3288-nicky-rev0.dtb";
            data = /incbin/("arch/arm/boot/dts/rk3288-nicky-rev0.dtb");
            type = "flat_dt";
            arch = "arm";
            compression = "none";
            hash@1{
                algo = "sha1";
            };
        };
        fdt@4{
            description = "rk3288-danger-rev0.dtb";
            data = /incbin/("arch/arm/boot/dts/rk3288-danger-rev0.dtb");
            type = "flat_dt";
            arch = "arm";
            compression = "none";
            hash@1{
                algo = "sha1";
            };
        };
        fdt@5{
            description = "rk3288-jerry-rev2.dtb";
            data = /incbin/("arch/arm/boot/dts/rk3288-jerry-rev2.dtb");
            type = "flat_dt";
            arch = "arm";
            compression = "none";
            hash@1{
                algo = "sha1";
            };
        };
        fdt@6{
	    description = "rk3288-rialto-rev0.dtb";
	    data = /incbin/("arch/arm/boot/dts/rk3288-rialto-rev0.dtb");
	    type = "flat_dt";
	    arch = "arm";
	    compression = "none";
	    hash@1{
		algo = "sha1";
	    };
	};
        fdt@7{
	    description = "rk3288-danger-rev1.dtb";
	    data = /incbin/("arch/arm/boot/dts/rk3288-danger-rev1.dtb");
	    type = "flat_dt";
	    arch = "arm";
	    compression = "none";
	    hash@1{
		algo = "sha1";
	    };
	};
        fdt@8{
	    description = "rk3288-jerry-rev3.dtb";
	    data = /incbin/("arch/arm/boot/dts/rk3288-jerry-rev3.dtb");
	    type = "flat_dt";
	    arch = "arm";
	    compression = "none";
	    hash@1{
		algo = "sha1";
	    };
	};
        fdt@9{
	    description = "rk3288-speedy.dtb";
	    data = /incbin/("arch/arm/boot/dts/rk3288-speedy.dtb");
	    type = "flat_dt";
	    arch = "arm";
	    compression = "none";
	    hash@1{
		algo = "sha1";
	    };
	};
        fdt@10{
	    description = "rk3288-evb-act8846.dtb";
	    data = /incbin/("arch/arm/boot/dts/rk3288-evb-act8846.dtb");
	    type = "flat_dt";
	    arch = "arm";
	    compression = "none";
	    hash@1{
		algo = "sha1";
	    };
	};
        fdt@11{
	    description = "rk3288-mickey-rev0.dtb";
	    data = /incbin/("arch/arm/boot/dts/rk3288-mickey-rev0.dtb");
	    type = "flat_dt";
	    arch = "arm";
	    compression = "none";
	    hash@1{
		algo = "sha1";
	    };
	};
        fdt@12{
	    description = "rk3288-speedy-rev1.dtb";
	    data = /incbin/("arch/arm/boot/dts/rk3288-speedy-rev1.dtb");
	    type = "flat_dt";
	    arch = "arm";
	    compression = "none";
	    hash@1{
		algo = "sha1";
	    };
	};
        fdt@13{
	    description = "rk3288-evb-rk808.dtb";
	    data = /incbin/("arch/arm/boot/dts/rk3288-evb-rk808.dtb");
	    type = "flat_dt";
	    arch = "arm";
	    compression = "none";
	    hash@1{
		algo = "sha1";
	    };
	};
        fdt@14{
	    description = "rk3288-mighty-rev1.dtb";
	    data = /incbin/("arch/arm/boot/dts/rk3288-mighty-rev1.dtb");
	    type = "flat_dt";
	    arch = "arm";
	    compression = "none";
	    hash@1{
		algo = "sha1";
	    };
	};
        fdt@15{
	    description = "rk3288-thea-rev0.dtb";
	    data = /incbin/("arch/arm/boot/dts/rk3288-thea-rev0.dtb");
	    type = "flat_dt";
	    arch = "arm";
	    compression = "none";
	    hash@1{
		algo = "sha1";
	    };
	};
        fdt@16{
	    description = "rk3288-gus-rev1.dtb";
	    data = /incbin/("arch/arm/boot/dts/rk3288-gus-rev1.dtb");
	    type = "flat_dt";
	    arch = "arm";
	    compression = "none";
	    hash@1{
		algo = "sha1";
	    };
	};
        fdt@17{
	    description = "rk3288-minnie-rev0.dtb";
	    data = /incbin/("arch/arm/boot/dts/rk3288-minnie-rev0.dtb");
	    type = "flat_dt";
	    arch = "arm";
	    compression = "none";
	    hash@1{
		algo = "sha1";
	    };
	};

    };
    configurations {
        default = "conf@1";
        conf@1{
            kernel = "kernel@1";
            fdt = "fdt@1";
        };
        conf@2{
            kernel = "kernel@1";
            fdt = "fdt@2";
        };
        conf@3{
            kernel = "kernel@1";
            fdt = "fdt@3";
        };
        conf@4{
            kernel = "kernel@1";
            fdt = "fdt@4";
        };
        conf@5{
            kernel = "kernel@1";
            fdt = "fdt@5";
        };
	conf@6{
	    kernel = "kernel@1";
	    fdt = "fdt@6";
	};
	conf@7{
	    kernel = "kernel@1";
	    fdt = "fdt@7";
	};
	conf@8{
	    kernel = "kernel@1";
	    fdt = "fdt@8";
	};
	conf@9{
	    kernel = "kernel@1";
	    fdt = "fdt@9";
	};
	conf@10{
	    kernel = "kernel@1";
	    fdt = "fdt@10";
	};
	conf@11{
	    kernel = "kernel@1";
	    fdt = "fdt@11";
	};
	conf@12{
	    kernel = "kernel@1";
	    fdt = "fdt@12";
	};
	conf@13{
	    kernel = "kernel@1:";
	    fdt = "fdt@13";
	};
	conf@14{
	    kernel = "kernel@1";
	    fdt = "fdt@14";
	};
	conf@15{
	    kernel = "kernel@1";
	    fdt = "fdt@15";
	};
	conf@16{
	    kernel = "kernel@1";
	    fdt = "fdt@16";
	};
	conf@17{
	    kernel = "kernel@1";
	    fdt = "fdt@17";
	};
    };
};
```
