## core/linux-gru/kernel.its
```
/dts-v1/;

/ {
    description = "Chrome OS kernel image with one or more FDT blobs";
    images {
        kernel@1{
            description = "kernel";
            data = /incbin/("arch/arm64/boot/Image");
            type = "kernel_noload";
            arch = "arm64";
            os = "linux";
            compression = "none";
            load = <0>;
            entry = <0>;
        };
        fdt@1{
            description = "rk3399-gru-bob-r0.dtb";
            data = /incbin/("arch/arm64/boot/dts/rockchip/rk3399-gru-bob-r0.dtb");
            type = "flat_dt";
            arch = "arm64";
            compression = "none";
            hash@1{
                algo = "sha1";
            };
        };
        fdt@2{
            description = "rk3399-gru-bob-r2.dtb";
            data = /incbin/("arch/arm64/boot/dts/rockchip/rk3399-gru-bob-r2.dtb");
            type = "flat_dt";
            arch = "arm64";
            compression = "none";
            hash@1{
                algo = "sha1";
            };
        };
        fdt@3{
            description = "rk3399-gru-bob-r4.dtb";
            data = /incbin/("arch/arm64/boot/dts/rockchip/rk3399-gru-bob-r4.dtb");
            type = "flat_dt";
            arch = "arm64";
            compression = "none";
            hash@1{
                algo = "sha1";
            };
        };
        fdt@4{
            description = "rk3399-gru-gru-r1.dtb";
            data = /incbin/("arch/arm64/boot/dts/rockchip/rk3399-gru-gru-r1.dtb");
            type = "flat_dt";
            arch = "arm64";
            compression = "none";
            hash@1{
                algo = "sha1";
            };
        };
        fdt@5{
            description = "rk3399-gru-gru-r2.dtb";
            data = /incbin/("arch/arm64/boot/dts/rockchip/rk3399-gru-gru-r2.dtb");
            type = "flat_dt";
            arch = "arm64";
            compression = "none";
            hash@1{
                algo = "sha1";
            };
        };
        fdt@6{
            description = "rk3399-gru-kevin-r5.dtb";
            data = /incbin/("arch/arm64/boot/dts/rockchip/rk3399-gru-kevin-r5.dtb");
            type = "flat_dt";
            arch = "arm64";
            compression = "none";
            hash@1{
                algo = "sha1";
            };
        };
        fdt@7{
            description = "rk3399-gru-kevin-r6.dtb";
            data = /incbin/("arch/arm64/boot/dts/rockchip/rk3399-gru-kevin-r6.dtb");
            type = "flat_dt";
            arch = "arm64";
            compression = "none";
            hash@1{
                algo = "sha1";
            };
        };
        fdt@8{
            description = "rk3399-gru-nefario-r0.dtb";
            data = /incbin/("arch/arm64/boot/dts/rockchip/rk3399-gru-nefario-r0.dtb");
            type = "flat_dt";
            arch = "arm64";
            compression = "none";
            hash@1{
                algo = "sha1";
            };
        };
        fdt@9{
            description = "rk3399-gru-rainier-r0.dtb";
            data = /incbin/("arch/arm64/boot/dts/rockchip/rk3399-gru-rainier-r0.dtb");
            type = "flat_dt";
            arch = "arm64";
            compression = "none";
            hash@1{
                algo = "sha1";
            };
        };
        fdt@10{
            description = "rk3399-gru-scarlet-r0.dtb";
            data = /incbin/("arch/arm64/boot/dts/rockchip/rk3399-gru-scarlet-r0.dtb");
            type = "flat_dt";
            arch = "arm64";
            compression = "none";
            hash@1{
                algo = "sha1";
            };
        };
        fdt@11{
            description = "rk3399-gru-scarlet-r1.dtb";
            data = /incbin/("arch/arm64/boot/dts/rockchip/rk3399-gru-scarlet-r1.dtb");
            type = "flat_dt";
            arch = "arm64";
            compression = "none";
            hash@1{
                algo = "sha1";
            };
        };
        fdt@12{
            description = "rk3399-gru-scarlet-r2.dtb";
            data = /incbin/("arch/arm64/boot/dts/rockchip/rk3399-gru-scarlet-r2.dtb");
            type = "flat_dt";
            arch = "arm64";
            compression = "none";
            hash@1{
                algo = "sha1";
            };
        };
        fdt@13{
            description = "rk3399-gru-scarlet-r3-sku7.dtb";
            data = /incbin/("arch/arm64/boot/dts/rockchip/rk3399-gru-scarlet-r3-sku7.dtb");
            type = "flat_dt";
            arch = "arm64";
            compression = "none";
            hash@1{
                algo = "sha1";
            };
        };
        fdt@14{
            description = "rk3399-gru-scarlet-r4-sku6.dtb";
            data = /incbin/("arch/arm64/boot/dts/rockchip/rk3399-gru-scarlet-r4-sku6.dtb");
            type = "flat_dt";
            arch = "arm64";
            compression = "none";
            hash@1{
                algo = "sha1";
            };
        };
    };
    configurations {
        default = "conf@1";
        conf@1{
            kernel = "kernel@1";
            fdt = "fdt@1";
        };
        conf@2{
            kernel = "kernel@1";
            fdt = "fdt@2";
        };
        conf@3{
            kernel = "kernel@1";
            fdt = "fdt@3";
        };
        conf@4{
            kernel = "kernel@1";
            fdt = "fdt@4";
        };
        conf@5{
            kernel = "kernel@1";
            fdt = "fdt@5";
        };
        conf@6{
            kernel = "kernel@1";
            fdt = "fdt@6";
        };
        conf@7{
            kernel = "kernel@1";
            fdt = "fdt@7";
        };
        conf@8{
            kernel = "kernel@1";
            fdt = "fdt@8";
        };
        conf@9{
            kernel = "kernel@1";
            fdt = "fdt@9";
        };
        conf@10{
            kernel = "kernel@1";
            fdt = "fdt@10";
        };
        conf@11{
            kernel = "kernel@1";
            fdt = "fdt@11";
        };
        conf@12{
            kernel = "kernel@1";
            fdt = "fdt@12";
        };
        conf@13{
            kernel = "kernel@1";
            fdt = "fdt@13";
        };
        conf@14{
            kernel = "kernel@1";
            fdt = "fdt@14";
        };
    };
};
```

## core/linux-nyan/kernel-nyan.its
```
/dts-v1/;

/ {
    description = "Chrome OS kernel image with one or more FDT blobs";
    images {
        kernel@1{
            description = "kernel";
            data = /incbin/("arch/arm/boot/zImage");
            type = "kernel_noload";
            arch = "arm";
            os = "linux";
            compression = "none";
            load = <0>;
            entry = <0>;
        };
        fdt@1{
            description = "tegra124-nyan-big-rev0_2.dtb";
            data = /incbin/("arch/arm/boot/dts/tegra124-nyan-big-rev0_2.dtb");
            type = "flat_dt";
            arch = "arm";
            compression = "none";
            hash@1{
                algo = "sha1";
            };
        };
        fdt@2{
            description = "tegra124-nyan-big-rev3_7.dtb";
            data = /incbin/("arch/arm/boot/dts/tegra124-nyan-big-rev3_7.dtb");
            type = "flat_dt";
            arch = "arm";
            compression = "none";
            hash@1{
                algo = "sha1";
            };
        };
        fdt@3{
            description = "tegra124-nyan-big-rev8_9.dtb";
            data = /incbin/("arch/arm/boot/dts/tegra124-nyan-big-rev8_9.dtb");
            type = "flat_dt";
            arch = "arm";
            compression = "none";
            hash@1{
                algo = "sha1";
            };
        };
        fdt@4{
            description = "tegra124-nyan-blaze.dtb";
            data = /incbin/("arch/arm/boot/dts/tegra124-nyan-blaze.dtb");
            type = "flat_dt";
            arch = "arm";
            compression = "none";
            hash@1{
                algo = "sha1";
            };
        };
        fdt@5{
            description = "tegra124-nyan-rev0.dtb";
            data = /incbin/("arch/arm/boot/dts/tegra124-nyan-rev0.dtb");
            type = "flat_dt";
            arch = "arm";
            compression = "none";
            hash@1{
                algo = "sha1";
            };
        };
        fdt@6{
            description = "tegra124-nyan-rev1.dtb";
            data = /incbin/("arch/arm/boot/dts/tegra124-nyan-rev1.dtb");
            type = "flat_dt";
            arch = "arm";
            compression = "none";
            hash@1{
                algo = "sha1";
            };
        };
        fdt@7{
            description = "tegra124-nyan-kitty-rev0_3.dtb";
            data = /incbin/("arch/arm/boot/dts/tegra124-nyan-kitty-rev0_3.dtb");
            type = "flat_dt";
            arch = "arm";
            compression = "none";
            hash@1{
                algo = "sha1";
            };
        };
        fdt@8{
            description = "tegra124-nyan-kitty-rev8.dtb";
            data = /incbin/("arch/arm/boot/dts/tegra124-nyan-kitty-rev8.dtb");
            type = "flat_dt";
            arch = "arm";
            compression = "none";
            hash@1{
                algo = "sha1";
            };
        };
    };
    configurations {
        default = "conf@1";
        conf@1{
            kernel = "kernel@1";
            fdt = "fdt@1";
        };
        conf@2{
            kernel = "kernel@1";
            fdt = "fdt@2";
        };
        conf@3{
            kernel = "kernel@1";
            fdt = "fdt@3";
        };
        conf@4{
            kernel = "kernel@1";
            fdt = "fdt@4";
        };
        conf@5{
            kernel = "kernel@1";
            fdt = "fdt@5";
        };
        conf@6{
            kernel = "kernel@1";
            fdt = "fdt@6";
        };
        conf@7{
            kernel = "kernel@1";
            fdt = "fdt@7";
        };
        conf@8{
            kernel = "kernel@1";
            fdt = "fdt@8";
        };
    };
};
```

## core/linux-peach/kernel.its
```
/dts-v1/;
 
/ {
    description = "Chrome OS kernel image with one or more FDT blobs";
    images {
        kernel@1{
            description = "kernel";
            data = /incbin/("arch/arm/boot/zImage");
            type = "kernel_noload";
            arch = "arm";
            os = "linux";
            compression = "none";
            load = <0>;
            entry = <0>;
        };
        fdt@1{
            description = "exynos5250-snow-rev4.dtb";
            data = /incbin/("arch/arm/boot/dts/exynos5250-snow-rev4.dtb");
            type = "flat_dt";
            arch = "arm";
            compression = "none";
            hash@1{
                algo = "sha1";
            };
        };
        fdt@2{
            description = "exynos5250-snow-rev5.dtb";
            data = /incbin/("arch/arm/boot/dts/exynos5250-snow-rev5.dtb");
            type = "flat_dt";
            arch = "arm";
            compression = "none";
            hash@1{
                algo = "sha1";
            };
        };
        fdt@3{
            description = "exynos5250-spring.dtb";
            data = /incbin/("arch/arm/boot/dts/exynos5250-spring.dtb");
            type = "flat_dt";
            arch = "arm";
            compression = "none";
            hash@1{
                algo = "sha1";
            };
        };
        fdt@4{
            description = "exynos5420-peach-kirby.dtb";
            data = /incbin/("arch/arm/boot/dts/exynos5420-peach-kirby.dtb");
            type = "flat_dt";
            arch = "arm";
            compression = "none";
            hash@1{
                algo = "sha1";
            };
        };
        fdt@5{
            description = "exynos5420-peach-pit.dtb";
            data = /incbin/("arch/arm/boot/dts/exynos5420-peach-pit.dtb");
            type = "flat_dt";
            arch = "arm";
            compression = "none";
            hash@1{
                algo = "sha1";
            };
        };
        fdt@6{
	    description = "exynos5420-peach-pit-rev3_5.dtb";
	    data = /incbin/("arch/arm/boot/dts/exynos5420-peach-pit-rev3_5.dtb");
	    type = "flat_dt";
	    arch = "arm";
	    compression = "none";
	    hash@1{
		algo = "sha1";
	    };
	};
        fdt@7{
	    description = "exynos5420-peach-pit-rev4.dtb";
	    data = /incbin/("arch/arm/boot/dts/exynos5420-peach-pit-rev4.dtb");
	    type = "flat_dt";
	    arch = "arm";
	    compression = "none";
	    hash@1{
		algo = "sha1";
	    };
	};
        fdt@8{
	    description = "exynos5422-peach-pi.dtb";
	    data = /incbin/("arch/arm/boot/dts/exynos5422-peach-pi.dtb");
	    type = "flat_dt";
	    arch = "arm";
	    compression = "none";
	    hash@1{
		algo = "sha1";
	    };
	};
        fdt@9{
	    description = "exynos5250-skate.dtb";
	    data = /incbin/("arch/arm/boot/dts/exynos5250-skate.dtb");
	    type = "flat_dt";
	    arch = "arm";
	    compression = "none";
	    hash@1{
		algo = "sha1";
	    };
	};

    };
    configurations {
        default = "conf@1";
        conf@1{
            kernel = "kernel@1";
            fdt = "fdt@1";
        };
        conf@2{
            kernel = "kernel@1";
            fdt = "fdt@2";
        };
        conf@3{
            kernel = "kernel@1";
            fdt = "fdt@3";
        };
        conf@4{
            kernel = "kernel@1";
            fdt = "fdt@4";
        };
        conf@5{
            kernel = "kernel@1";
            fdt = "fdt@5";
        };
	conf@6{
	    kernel = "kernel@1";
	    fdt = "fdt@6";
	};
	conf@7{
	    kernel = "kernel@1";
	    fdt = "fdt@7";
	};
	conf@8{
	    kernel = "kernel@1";
	    fdt = "fdt@8";
	};
	conf@9{
	    kernel = "kernel@1";
	    fdt = "fdt@9";
	};
    };
};
```
